## git_home/u-boot.git/configs/alpine_hw29765235p0p512p1024p4x4p4x4_32_db_defconfig
```kconfig
CONFIG_ARM=y
CONFIG_ALPINE_HW29765235P0P512P1024P4X4P4X4_32=y
CONFIG_TARGET_ALPINE_HW29765235P0P512P1024P4X4P4X4_32_DB=y
CONFIG_OF_EMBED=y
CONFIG_OF_CONTROL=y
CONFIG_DEFAULT_DEVICE_TREE="al_stub"
```

## git_home/u-boot.git/configs/alpine_hw29765294p0p128p512p8x8p4x4_32_db_defconfig
```kconfig
CONFIG_ARM=y
CONFIG_ALPINE_HW29765294P0P128P512P8X8P4X4_32=y
CONFIG_TARGET_ALPINE_HW29765294P0P128P512P8X8P4X4_32_DB=y
CONFIG_OF_EMBED=y
CONFIG_OF_CONTROL=y
CONFIG_DEFAULT_DEVICE_TREE="al_stub"
```

## git_home/u-boot.git/configs/alpine_v2_32_db_defconfig
```kconfig
CONFIG_ARM=y
CONFIG_ALPINE_V2_32=y
CONFIG_TARGET_ALPINE_V2_32_DB=y
CONFIG_OF_EMBED=y
CONFIG_OF_CONTROL=y
CONFIG_DEFAULT_DEVICE_TREE="al_stub"
```

## git_home/u-boot.git/configs/alpine_v2_64_db_defconfig
```kconfig
CONFIG_ARM=y
CONFIG_ALPINE_V2_64=y
CONFIG_TARGET_ALPINE_V2_64_DB=y
CONFIG_OF_EMBED=y
CONFIG_OF_CONTROL=y
CONFIG_DEFAULT_DEVICE_TREE="al_stub"
```

## package/lib-dni-common-api/Config.in
```kconfig
config DNI_COMMON_API
	bool "support COMMON API to Fix net-cgi security issues"
	default y
	help
	  If DNI common api was enabled, could set this config.

	  If unsure, say N.
```
