## git_home/linux.git/Documentation/devicetree/bindings/arm/al/al-ccu.txt
```
Annapurna Labs Cache Coherency Unit

Properties:
- compatible : Should contain "annapurna-labs,al-ccu".
- reg : Offset and length of the register set for the device.
- io_coherency : enable io-coherency (int, enabled if !=0)

Example:

ccu {
	compatible = "annapurna-labs,al-ccu";
	reg = <0x0 0xfb090000 0x0 0x10000>;
	io_coherency = <1>;
};
```

## git_home/linux.git/Documentation/devicetree/bindings/arm/al/al-cpu-resume.txt
```
Annapurna Labs CPU resume registers

Properties:
- compatible : Should contain "annapurna-labs,al-cpu-resume".
- reg : Offset and length of the register set for the device

Example:

cpu_resume {
	compatible = "annapurna-labs,al-cpu-resume";
	reg = <0xfbff5ed0 0x30>;
};
```

## git_home/linux.git/Documentation/devicetree/bindings/arm/al/al-external-pcie.txt
```
Annapurna Labs PCIe Controller

Properties:
- compatible : Should contain "annapurna-labs,al-pcie"
- reg : register space of the conroller
- device_type : "pci"
- #size-cells : <2>
- #address-cells : <3>
- bus-range: PCI bus numbers covered
- ranges: ranges for the PCI memory and I/O regions

Example:

pcie-external0 {
	compatible = "annapurna-labs,al-pci";
	reg = <0xfd800000 0x00020000>; /* controller 0 registers */
	device_type = "pci";
	#size-cells = <2>;
	#address-cells = <3>;

	/* ranges:
	 * Controller 0:
	 * - ECAM - non prefetchable config space: 2MB
	 * - IO - IO port space 64KB, reserve 64KB from target memory windows
	 * - 32 bit non prefetchable memory space: 128MB - 64KB
	 */
	ranges = <0x00000000 0x0 0xfb600000 0xfb600000 0x0 0x00200000
		  0x01000000 0x0 0xe0000000 0xe0000000 0x0 0x00010000
		  0x02000000 0x0 0xe0010000 0xe0010000 0x0 0x07ff0000>;

	bus-range = <0x00 0xff>;
};
```

## git_home/linux.git/Documentation/devicetree/bindings/arm/al/al-internal-pcie.txt
```
Annapurna Labs Internal PCIe Controller

Properties:
- compatible : Should contain "annapurna-labs,al-internal-pcie"
- device_type : "pci"
- #size-cells : <2>
- #address-cells : <3>
- #interrupt-cells : <1>
- interrupt-parent = <&gic_main>;
- interrupt-map-mask = <0xf800 0 0 7>
	The irq depends on the pci device number, so we set the mask to 0xf800.
	All devices use interrupt INTA, so we set the mask to 7 and in the map
	only INTA is added.
- interrupt-map = <0x1800 0 0 1 &gic_main 0 112 4>: for device number 3 (0x1800 >> 11)
	irq 144 (112 + 32) for INTA is assigned.

- ranges : citation from :
	   ranges is a list of address translations. Each entry in the ranges
	   table is a tuple containing the child address, the parent address,
	   and the size of the region in the child address space. The size of
	   each field is determined by taking the child's #address-cells
	   value, the parent's #address-cells value, and the child's #size-cells
	   value.
           Child addresses (PCI addresses) use 3 cells, and PCI ranges are
	   encoded into 2 cells. The first question might be, why do we need
	   three 32 bit cells to specify a PCI address. The three cells are
	   labeled phys.hi, phys.mid and phys.low [2].
	   phys.hi cell: npt000ss bbbbbbbb dddddfff rrrrrrrr
	   phys.mid cell: hhhhhhhh hhhhhhhh hhhhhhhh hhhhhhhh
	   phys.low cell: llllllll llllllll llllllll llllllll
	   PCI addresses are 64 bits wide, and are encoded into phys.mid and
	   phys.low. However, the really interesting things are in phys.high
	   which is a bit field:
	   - n: relocatable region flag (doesn't play a role here)
	   - p: prefetchable (cacheable) region flag
	   - t: aliased address flag (doesn't play a role here)
	   - ss: space code
	   - 00: configuration space
	   - 01: I/O space
	   - 10: 32 bit memory space
	   - 11: 64 bit memory space
	   - bbbbbbbb: The PCI bus number. PCI may be structured hierarchically.
	               So we may have PCI/PCI bridges which will define sub busses.
	   - ddddd: The device number, typically associated with IDSEL signal
	            connections.
	   - fff: The function number. Used for multifunction PCI devices.
	   - rrrrrrrr: Register number; used for configuration cycles.
	   For the purpose of PCI address translation, the important fields
	   are p and ss. The value of p and ss in phys.hi determines which PCI
	   address space is being accessed. So looking onto our ranges
	   property, we have three regions: a 32 bit prefetchable memory
	   region beginning on PCI address 0x80000000 of 512 MByte size which
	   will be mapped onto address 0x80000000 on the host CPU.  a 32 bit
	   non-prefetchable memory region beginning on PCI address 0xa0000000
	   of 256 MByte size which will be mapped onto address 0xa0000000 on
	   the host CPU.  an I/O region beginning on PCI address 0x00000000 of
	   16 MByte size which will be mapped onto address 0xb0000000 on the
	   host CPU.  To throw a wrench into the works, the presence of the
	   phys.hi bitfield means that an operating system needs to know that
	   the node represents a PCI bridge so that it can ignore the
	   irrelevant fields for the purpose of translation. An OS will look
	   for the string "pci" in the PCI bus nodes to determine whether it
	   needs to mask of the extra fields.

Example:

pcie-internal {
	compatible = "annapurna-labs,al-internal-pcie";
	device_type = "pci";
	#size-cells = <2>;
	#address-cells = <3>;
	#interrupt-cells = <1>;
	interrupt-parent = <&gic_main>;
	interrupt-map-mask = <0xf800 0 0 7>;
	interrupt-map = <0x0000 0 0 1 &gic_main 0 64 4>;

	/* ranges:
	 * - ECAM - non prefetchable config space
	 * - 32 bit non prefetchable memory space
	 */
	ranges = <0x00000000 0x0 0xfbc00000 0xfbc00000 0x0 0x100000
		  0x02000000 0x0 0xfe000000 0xfe000000 0x0 0x1000000>;
};
```

## git_home/linux.git/Documentation/devicetree/bindings/arm/al/al-mc.txt
```
Annapurna Labs MC (Memory Controller)

Properties:
- compatible : Should contain "annapurna-labs,al-mc".
- reg : Offset and length of the register set for the device.

Example:

mc {
	compatible = "annapurna-labs,al-mc";
	reg = <0x0 0xfb080000 0x0 0x00010000>;
};
```

## git_home/linux.git/Documentation/devicetree/bindings/arm/al/al-msix.txt
```
Annapurna Labs MSIX handler

Properties:
- compatible : Should contain "annapurna-labs,al-msix".
- reg : Offset and length of the MSIX address space
- interrupts : first and last irq to be configured as edge triggered, as
               required for MSIX

Example:

msix {
	compatible = "annapurna-labs,al-msix";
	reg = <0xfbe00000 0x100000>;
	interrupts = <0 96 1 0 159 1>;
};
```

## git_home/linux.git/Documentation/devicetree/bindings/arm/al/al-nand.txt
```
Annapurna Labs NAND controller

Required properties:
  - compatible : should be "annapurna-labs,al-nand"
  - reg : Offset and length of the nand base.
  - interrupts : The interrupt number.

Optional properties:
  - #address-cells : required when using partitions and should be set to <1>
  - #size-cells : required when using partitions and should be set to <1>

  The device tree may optionally contain sub-nodes describing partitions of the
  address space. See partition.txt for more detail.

Examples:

nand-flash {
	compatible = "annapurna-labs,al-nand";
	reg = <0xfa100000 0x00202000>;
	interrupts = <0 1 4>;

	#address-cells = <1>;
	#size-cells = <1>;

	partition@0 {
		...
	};

};
```

## git_home/linux.git/Documentation/devicetree/bindings/arm/al/al-nb-service.txt
```
Annapurna Labs North Bridge Service Registers

Properties:
- compatible : Should contain "annapurna-labs,al-nb-service".
- reg : Offset and length of the register set for the device
- interrupts : The sys fabric interrupts indices
- dev_ord_relax : enable device-order relaxation. This option
				will allow relaxing order constraints between
				reads and writes to different addresses.
				(int, enabled if !=0)

Example:

nb_service {
	compatible = "annapurna-labs,al-nb-service";
	reg = <0xfb070000 0x10000>;
	interrupts = <0 64 4  0 65 4  0 66 4  0 67 4>;
	dev_ord_relax = <1>;
};
```

## git_home/linux.git/Documentation/devicetree/bindings/arm/al/al-sata.txt
```
Annapurna Labs AHCI Controller

GPIOs used to expose the sata ports presence and activity.

Properties:
- compatible : Should contain "annapurna-labs,al-sata-sw-leds".

each led represents the GPIO used for each sata port, the port represented
by the AHCI pci address (domian, bus, dev), host 0 @ 00:00:08, and host 1
@ 00:00:09.
and the port number within that host.

sata_sw_leds {
	compatible = "annapurna-labs,al-sata-sw-leds";
	led@0 {
		label = "host 0, port 0 activity&presence led";
		pci_domain = <0>;
		pci_bus = <0>;
		pci_dev = <8>;
		port = <0>;
		gpios =<&gpio0 1 0>;
	};
	led@1 {
		label = "host 0, port 1 activity&presence led";
		pci_domain = <0>;
		pci_bus = <0>;
		pci_dev = <8>;
		port = <1>;
		gpios =<&gpio0 2 0>;
	};
};
```

## git_home/linux.git/Documentation/devicetree/bindings/arm/al/al-serdes.txt
```
Annapurna Labs SerDes Registers

Properties:
- compatible : Should contain "annapurna-labs,al-serdes".
- reg : Offset and length of the register set for the device

Example:

serdes {
	compatible = "annapurna-labs,al-serdes";
	reg = <0x0 0xfd8c0000 0x0 0x1000>;
};
```

## git_home/linux.git/Documentation/devicetree/bindings/arm/al/al-thermal.txt
```
Annapurna Labs Thermal Sensor Device

Properties:
- compatible : Should contain "annapurna-labs,al-thermal".
- reg : Offset and length of the register set for the device

Example:

thermal {
	compatible = "annapurna-labs,al-thermal";
	reg = <0xfd860a00 0x100>;
};
```

## git_home/linux.git/Documentation/devicetree/bindings/arm/al/al-usb.txt
```
Annapurna Labs USB Controller

Properties:
- compatible : Should contain "annapurna-labs,al-usb".
- serdes-group : SerDes group used for USB3.0 phy
- serdes-lane : SerDes lane used for USB3.0 phy

Example:

usb {
	compatible = "annapurna-labs,al-usb";
	serdes-group = <0>;
	serdes-lane = <2>;
};
```

## git_home/linux.git/Documentation/devicetree/bindings/spi/spi-dw.txt
```
DesignWare SPI device

Required properties:
- compatible : should be "snps,dw-spi-mmio" or "snps,dw-spi-pci"
- reg : offset and length of the register set for the device
- interrupts: The interrupt number to the cpu. The interrupt specifier format
  depends on the interrupt controller.
- num-chipselect: Contains the number of the chipselect
- bus-num: Bus number

Example:
		spi: spi@fff00000 {
				compatible = "snps,dw-spi-mmio";
				#address-cells = <1>;
				#size-cells = <0>;
				reg = <0xfff00000 0x1000>;
				interrupts = <0 154 4>;
				num-chipselect = <4>;
				bus-num = <0>;
		};
```
