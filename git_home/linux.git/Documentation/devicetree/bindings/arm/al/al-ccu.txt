## git_home/linux.git/arch/arm/configs/alpine_defconfig
```kconfig
CONFIG_EXPERIMENTAL=y
# CONFIG_LOCALVERSION_AUTO is not set
CONFIG_SYSVIPC=y
CONFIG_NO_HZ=y
CONFIG_HIGH_RES_TIMERS=y
CONFIG_IKCONFIG=y
CONFIG_IKCONFIG_PROC=y
CONFIG_BLK_DEV_INITRD=y
CONFIG_SLAB=y
CONFIG_PROFILING=y
CONFIG_MODULES=y
CONFIG_MODULE_UNLOAD=y
CONFIG_PARTITION_ADVANCED=y
CONFIG_ARCH_ALPINE=y
CONFIG_PCI_MSI=y
CONFIG_PCI_IOV=y
CONFIG_SMP=y
# CONFIG_SMP_ON_UP is not set
CONFIG_ARM_ARCH_TIMER=y
CONFIG_AEABI=y
CONFIG_HIGHMEM=y
CONFIG_HIGHPTE=y
CONFIG_USE_OF=y
CONFIG_ZBOOT_ROM_TEXT=0x0
CONFIG_ZBOOT_ROM_BSS=0x0
CONFIG_CMDLINE="root=1f03 mem=32M"
CONFIG_CPU_IDLE=y
CONFIG_VFP=y
CONFIG_NEON=y
CONFIG_NET=y
CONFIG_PACKET=y
CONFIG_UNIX=y
CONFIG_XFRM_USER=y
CONFIG_NET_KEY=y
CONFIG_INET=y
CONFIG_IP_MULTICAST=y
CONFIG_IP_PNP=y
CONFIG_IP_PNP_BOOTP=y
CONFIG_INET_AH=y
CONFIG_INET_ESP=y
# CONFIG_INET_DIAG is not set
# CONFIG_IPV6 is not set
CONFIG_DEVTMPFS=y
CONFIG_DEVTMPFS_MOUNT=y
CONFIG_MTD=y
CONFIG_MTD_CMDLINE_PARTS=y
CONFIG_MTD_CHAR=y
CONFIG_MTD_BLOCK=y
CONFIG_MTD_CFI=y
CONFIG_MTD_CFI_ADV_OPTIONS=y
CONFIG_MTD_CFI_INTELEXT=y
CONFIG_MTD_PHYSMAP_OF=y
CONFIG_MTD_M25P80=y
CONFIG_MTD_NAND=y
CONFIG_MTD_NAND_AL=y
CONFIG_MTD_UBI=y
CONFIG_PROC_DEVICETREE=y
CONFIG_BLK_DEV_LOOP=y
CONFIG_BLK_DEV_NVME=y
CONFIG_BLK_DEV_RAM=y
CONFIG_BLK_DEV_SD=y
CONFIG_SCSI_MPT2SAS=m
CONFIG_ATA=y
CONFIG_SATA_AHCI=y
CONFIG_SATA_AHCI_PLATFORM=y
CONFIG_SATA_SIL24=m
# CONFIG_ATA_BMDMA is not set
CONFIG_MD=y
CONFIG_BLK_DEV_MD=y
CONFIG_MD_LINEAR=y
CONFIG_MD_RAID0=y
CONFIG_MD_RAID1=y
CONFIG_MD_RAID10=y
CONFIG_MD_RAID456=y
CONFIG_MD_FAULTY=y
CONFIG_BLK_DEV_DM=y
CONFIG_DM_CRYPT=y
CONFIG_TARGET_CORE=m
CONFIG_TCM_IBLOCK=m
CONFIG_TCM_FILEIO=m
CONFIG_TCM_PSCSI=m
CONFIG_LOOPBACK_TARGET=m
CONFIG_ISCSI_TARGET=m
CONFIG_NETDEVICES=y
CONFIG_BONDING=m
CONFIG_MII=y
CONFIG_NET_TEAM=m
CONFIG_NET_TEAM_MODE_BROADCAST=m
CONFIG_NET_TEAM_MODE_ROUNDROBIN=m
CONFIG_NET_TEAM_MODE_ACTIVEBACKUP=m
CONFIG_NET_TEAM_MODE_LOADBALANCE=m
# CONFIG_NET_VENDOR_3COM is not set
# CONFIG_NET_VENDOR_ADAPTEC is not set
# CONFIG_NET_VENDOR_ALTEON is not set
CONFIG_NET_AL_ETH=y
# CONFIG_NET_VENDOR_AMD is not set
# CONFIG_NET_VENDOR_ATHEROS is not set
# CONFIG_NET_CADENCE is not set
# CONFIG_NET_VENDOR_BROADCOM is not set
# CONFIG_NET_VENDOR_BROCADE is not set
# CONFIG_NET_VENDOR_CHELSIO is not set
# CONFIG_NET_VENDOR_CIRRUS is not set
# CONFIG_NET_VENDOR_CISCO is not set
# CONFIG_NET_VENDOR_DEC is not set
# CONFIG_NET_VENDOR_DLINK is not set
# CONFIG_NET_VENDOR_EMULEX is not set
# CONFIG_NET_VENDOR_EXAR is not set
# CONFIG_NET_VENDOR_FARADAY is not set
# CONFIG_NET_VENDOR_HP is not set
CONFIG_E100=m
CONFIG_E1000=m
CONFIG_E1000E=m
CONFIG_IGB=m
CONFIG_IXGBE=m
# CONFIG_NET_VENDOR_I825XX is not set
# CONFIG_NET_VENDOR_MARVELL is not set
# CONFIG_NET_VENDOR_MELLANOX is not set
# CONFIG_NET_VENDOR_MICREL is not set
# CONFIG_NET_VENDOR_MYRI is not set
# CONFIG_NET_VENDOR_NATSEMI is not set
# CONFIG_NET_VENDOR_NVIDIA is not set
# CONFIG_NET_VENDOR_OKI is not set
# CONFIG_NET_PACKET_ENGINE is not set
# CONFIG_NET_VENDOR_QLOGIC is not set
# CONFIG_NET_VENDOR_REALTEK is not set
# CONFIG_NET_VENDOR_RDC is not set
# CONFIG_NET_VENDOR_SEEQ is not set
# CONFIG_NET_VENDOR_SILAN is not set
# CONFIG_NET_VENDOR_SIS is not set
# CONFIG_NET_VENDOR_SMSC is not set
# CONFIG_NET_VENDOR_STMICRO is not set
# CONFIG_NET_VENDOR_SUN is not set
# CONFIG_NET_VENDOR_TEHUTI is not set
# CONFIG_NET_VENDOR_TI is not set
# CONFIG_NET_VENDOR_VIA is not set
# CONFIG_NET_VENDOR_WIZNET is not set
CONFIG_AT803X_PHY=y
CONFIG_AQR105_PHY=y
CONFIG_INPUT_EVDEV=y
# CONFIG_SERIO_SERPORT is not set
CONFIG_SERIO_AMBAKMI=y
CONFIG_LEGACY_PTY_COUNT=16
CONFIG_SERIAL_8250=y
CONFIG_SERIAL_8250_CONSOLE=y
CONFIG_SERIAL_8250_EXTENDED=y
CONFIG_SERIAL_8250_MANY_PORTS=y
CONFIG_SERIAL_8250_SHARE_IRQ=y
CONFIG_SERIAL_8250_RSA=y
CONFIG_SERIAL_8250_DW=y
CONFIG_SERIAL_AMBA_PL011=y
CONFIG_SERIAL_AMBA_PL011_CONSOLE=y
CONFIG_SERIAL_OF_PLATFORM=y
CONFIG_I2C=y
CONFIG_I2C_CHARDEV=y
CONFIG_I2C_MUX=y
CONFIG_I2C_MUX_PCA954x=y
CONFIG_I2C_DESIGNWARE_PLATFORM=y
CONFIG_SPI=y
CONFIG_SPI_DESIGNWARE=y
CONFIG_SPI_DW_MMIO=y
CONFIG_PTP_1588_CLOCK=y
CONFIG_GPIOLIB=y
CONFIG_GPIO_SYSFS=y
CONFIG_GPIO_PL061=y
# CONFIG_HWMON is not set
CONFIG_THERMAL=y
CONFIG_AL_THERMAL=y
CONFIG_WATCHDOG=y
CONFIG_ARM_SP805_WATCHDOG=y
# CONFIG_HID is not set
# CONFIG_USB_HID is not set
CONFIG_USB=y
CONFIG_USB_XHCI_HCD=y
CONFIG_USB_STORAGE=y
CONFIG_NEW_LEDS=y
CONFIG_LEDS_CLASS=y
CONFIG_LEDS_GPIO=y
CONFIG_LEDS_TRIGGERS=y
CONFIG_LEDS_TRIGGER_TIMER=y
CONFIG_LEDS_TRIGGER_ONESHOT=y
CONFIG_LEDS_TRIGGER_HEARTBEAT=y
CONFIG_LEDS_TRIGGER_BACKLIGHT=y
CONFIG_LEDS_TRIGGER_CPU=y
CONFIG_LEDS_TRIGGER_GPIO=y
CONFIG_LEDS_TRIGGER_DEFAULT_ON=y
CONFIG_LEDS_TRIGGER_NETDEV=y
CONFIG_EDAC=y
CONFIG_EDAC_MM_EDAC=y
CONFIG_EDAC_AL_MC=y
CONFIG_RTC_CLASS=y
CONFIG_RTC_DRV_BQ32K=y
CONFIG_DMADEVICES=y
CONFIG_AL_DMA=y
CONFIG_AL_PCIE_RMN_1010=n
CONFIG_AL_DMA_PCI_IOV=y
CONFIG_AL_DMA_STATS=y
CONFIG_ASYNC_TX_DMA=y
# CONFIG_IOMMU_SUPPORT is not set
CONFIG_EXT2_FS=y
CONFIG_EXT3_FS=y
CONFIG_EXT4_FS=y
CONFIG_XFS_FS=y
CONFIG_BTRFS_FS=y
CONFIG_VFAT_FS=y
CONFIG_TMPFS=y
CONFIG_TMPFS_POSIX_ACL=y
CONFIG_CONFIGFS_FS=y
CONFIG_ECRYPT_FS=y
CONFIG_JFFS2_FS=y
CONFIG_UBIFS_FS=y
CONFIG_CRAMFS=y
CONFIG_MINIX_FS=y
CONFIG_ROMFS_FS=y
CONFIG_NFS_FS=y
CONFIG_ROOT_NFS=y
CONFIG_NFSD=y
CONFIG_NFSD_V3=y
CONFIG_CIFS=y
CONFIG_NLS_CODEPAGE_437=y
CONFIG_NLS_CODEPAGE_850=y
CONFIG_NLS_ISO8859_1=y
CONFIG_MAGIC_SYSRQ=y
CONFIG_DEBUG_KERNEL=y
CONFIG_DEBUG_INFO=y
CONFIG_ENABLE_DEFAULT_TRACERS=y
CONFIG_DEBUG_USER=y
CONFIG_DEBUG_LL=y
CONFIG_EARLY_PRINTK=y
CONFIG_KEYS=y
CONFIG_ENCRYPTED_KEYS=y
# CONFIG_CRYPTO_MANAGER_DISABLE_TESTS is not set
CONFIG_CRYPTO_TEST=m
CONFIG_CRYPTO_SHA1=y
CONFIG_CRYPTO_SHA512=y
CONFIG_CRYPTO_DEV_AL_CRYPTO=y
CONFIG_CRYPTO_DEV_AL_CRYPTO_STATS=y
```

## git_home/linux.git/drivers/usb/dwc3/Kconfig
```kconfig
config USB_DWC3
	tristate "DesignWare USB3 DRD Core Support"
	depends on (USB || USB_GADGET) && GENERIC_HARDIRQS
	select USB_XHCI_PLATFORM if USB_SUPPORT && USB_XHCI_HCD
	help
	  Say Y or M here if your system has a Dual Role SuperSpeed
	  USB controller based on the DesignWare USB3 IP Core.

	  If you choose to build this driver is a dynamically linked
	  module, the module will be called dwc3.ko.

if USB_DWC3

choice
	bool "DWC3 Mode Selection"
	default USB_DWC3_DUAL_ROLE if (USB && USB_GADGET)
	default USB_DWC3_HOST if (USB && !USB_GADGET)
	default USB_DWC3_GADGET if (!USB && USB_GADGET)

config USB_DWC3_HOST
	bool "Host only mode"
	depends on USB=y || USB=USB_DWC3
	help
	  Select this when you want to use DWC3 in host mode only,
	  thereby the gadget feature will be regressed.

config USB_DWC3_GADGET
	bool "Gadget only mode"
	depends on USB_GADGET=y || USB_GADGET=USB_DWC3
	help
	  Select this when you want to use DWC3 in gadget mode only,
	  thereby the host feature will be regressed.

config USB_DWC3_DUAL_ROLE
	bool "Dual Role mode"
	depends on ((USB=y || USB=USB_DWC3) && (USB_GADGET=y || USB_GADGET=USB_DWC3))
	help
	  This is the default mode of working of DWC3 controller where
	  both host and gadget features are enabled.

endchoice

config USB_DWC3_DEBUG
	bool "Enable Debugging Messages"
	help
	  Say Y here to enable debugging messages on DWC3 Driver.

config USB_DWC3_VERBOSE
	bool "Enable Verbose Debugging Messages"
	depends on USB_DWC3_DEBUG
	help
	  Say Y here to enable verbose debugging messages on DWC3 Driver.

config USB_DWC3_AL
	bool "Annapurna Labs USB3 Core Support"
	select USB_DWC3_AL_RMN_2648
	select USB_DWC3_AL_VBUS_GPIO
	help
	  Say Y here to enable Annapurna Labs USB3 core support.

config USB_DWC3_AL_RMN_2648
	bool "Annapurna Labs USB3 Core RMN 2648 fix"
	depends on USB_DWC3_AL
	help
	  Say Y here to enable Annapurna Labs USB3 core RMN 2648 fix.

config USB_DWC3_AL_VBUS_GPIO
	bool "Annapurna Labs USB3 Core Vbus indication using GPIO"
	depends on USB_DWC3_AL
	help
	  Say Y here to enable Annapurna Labs USB3 core Vbus indication
	  using GPIO.

endif
```

## git_home/u-boot.git/arch/arm/cpu/armv7/alpine/Kconfig
```kconfig
if ALPINE

config SYS_VENDOR
	default "annapurna-labs"

config SYS_SOC
	default "alpine"

endif
```

## git_home/u-boot.git/arch/arm/cpu/armv7/alpine_hw29765235p0p512p1024p4x4p4x4/Kconfig
```kconfig
if ALPINE_HW29765235P0P512P1024P4X4P4X4_32

config SYS_VENDOR
	default "annapurna-labs"

config SYS_SOC
	default "alpine_hw29765235p0p512p1024p4x4p4x4"

endif
```

## git_home/u-boot.git/arch/arm/cpu/armv7/alpine_hw29765294p0p128p512p8x8p4x4/Kconfig
```kconfig
if ALPINE_HW29765294P0P128P512P8X8P4X4_32

config SYS_VENDOR
	default "annapurna-labs"

config SYS_SOC
	default "alpine_hw29765294p0p128p512p8x8p4x4"

endif
```

## git_home/u-boot.git/arch/arm/cpu/armv7/alpine_v2/Kconfig
```kconfig
if ALPINE_V2_32

config SYS_VENDOR
	default "annapurna-labs"

config SYS_SOC
	default "alpine_v2"

endif
```

## git_home/u-boot.git/arch/arm/cpu/armv8/alpine_v2/Kconfig
```kconfig
if ALPINE_V2_64

config SYS_VENDOR
	default "annapurna-labs"

config SYS_SOC
	default "alpine_v2"

endif
```

## git_home/u-boot.git/board/annapurna-labs/Kconfig
```kconfig
choice
	prompt "Alpine board select"

config TARGET_ALPINE_DB
	bool "Alpine development board"

config TARGET_ALPINE_V2_32_DB
	bool "Alpine V2 development board - 32 bits"

config TARGET_ALPINE_HW29765235P0P512P1024P4X4P4X4_32_DB
	bool "Alpine hw29765235p0p512p1024p4x4p4x4 development board - 32 bits"

config TARGET_ALPINE_HW29765294P0P128P512P8X8P4X4_32_DB
	bool "Alpine hw29765294p0p128p512p8x8p4x4 development board - 32 bits"

config TARGET_ALPINE_V2_64_DB
	bool "Alpine V2 development board - 64 bits"

endchoice

if TARGET_ALPINE_DB

config SYS_BOARD
	default "alpine_db"

config SYS_CONFIG_NAME
	default "alpine_db"

endif

if TARGET_ALPINE_V2_32_DB

config SYS_BOARD
	default "alpine_db"

config SYS_CONFIG_NAME
	default "alpine_v2_32_db"

endif

if TARGET_ALPINE_HW29765235P0P512P1024P4X4P4X4_32_DB

config SYS_BOARD
	default "alpine_hw29765235p0p512p1024p4x4p4x4_32_db"

config SYS_CONFIG_NAME
	default "alpine_hw29765235p0p512p1024p4x4p4x4_32_db"

endif

if TARGET_ALPINE_HW29765294P0P128P512P8X8P4X4_32_DB

config SYS_BOARD
	default "alpine_hw29765294p0p128p512p8x8p4x4_32_db"

config SYS_CONFIG_NAME
	default "alpine_hw29765294p0p128p512p8x8p4x4_32_db"

endif

if TARGET_ALPINE_V2_64_DB

config SYS_BOARD
	default "alpine_db"

config SYS_CONFIG_NAME
	default "alpine_v2_64_db"

endif
```

## git_home/u-boot.git/board/qcom/hw29764958p0p128p512p3x3p4x4/Kconfig
```kconfig
if TARGET_HW29764958P0P128P512P3X3P4X4

config SYS_CPU
	string
	default "armv7"

config SYS_BOARD
	string
	default "hw29764958p0p128p512p3x3p4x4"

config SYS_VENDOR
	string
	default "qcom"

config SYS_SOC
	string
	default "ipq"

config SYS_CONFIG_NAME
	string
	default "hw29764958p0p128p512p3x3p4x4"

endif
```

## git_home/u-boot.git/board/qcom/ipq806x_cdp/Kconfig
```kconfig
if TARGET_IPQ806X_CDP

config SYS_CPU
	string
	default "armv7"

config SYS_BOARD
	string
	default "ipq806x_cdp"

config SYS_VENDOR
	string
	default "qcom"

config SYS_SOC
	string
	default "ipq"

config SYS_CONFIG_NAME
	string
	default "ipq806x_cdp"

endif
```

## git_home/u-boot.git/configs/alpine_db_defconfig
```kconfig
CONFIG_ARM=y
CONFIG_ALPINE=y
CONFIG_TARGET_ALPINE_DB=y
CONFIG_OF_EMBED=y
CONFIG_OF_CONTROL=y
CONFIG_DEFAULT_DEVICE_TREE="al_stub"
```
